## CMakeLists.txt
```
# SPDX-License-Identifier: Apache-2.0

cmake_minimum_required(VERSION 3.20.0)

find_package(Zephyr REQUIRED HINTS $ENV{ZEPHYR_BASE})
project(wifi_sensor)

target_sources(app PRIVATE src/main.c src/wifi.c)
```

## Kconfig
```
# SPDX-License-Identifier: Apache-2.0

rsource "./Kconfig.mcumgr"
source "Kconfig.zephyr"
```

## Kconfig.mcumgr
```
# SPDX-License-Identifier: Apache-2.0

config APP_MCUMGR_OTA
    bool "Enable OTA with mcumgr"
    help
        "Enable OTA with mcumgr"
    select BOOTLOADER_MCUBOOT
    select MCUMGR
    select CRC
    select ZCBOR
    select NET_SOCKETS
    select NET_SOCKETS_POSIX_NAMES
    select MCUMGR_TRANSPORT_UDP
    select MCUMGR_TRANSPORT_UDP_IPV6
    select FLASH
    select STREAM_FLASH
    select IMG_MANAGER
    select FLASH_MAP
    # Features
    select MCUMGR_GRP_IMG
    select MCUMGR_GRP_OS
    select MCUMGR_GRP_SHELL
    select SHELL_BACKEND_DUMMY

# Stack needs to be > 1024:
# 0x3ffb0638 smp_udp6                         (real size 2048):	unused 1128	usage  920 / 2048 (44 %)
config MCUMGR_TRANSPORT_UDP_STACK_SIZE
    default 2048
    depends on MCUMGR_TRANSPORT_UDP

config SYSTEM_WORKQUEUE_STACK_SIZE
    default 2304
```

## prj.conf
```kconfig
# SPDX-License-Identifier: Apache-2.0

CONFIG_LOG=y
CONFIG_SHELL=y
CONFIG_WIFI=y

CONFIG_NETWORKING=y
CONFIG_NET_L2_ETHERNET=y
CONFIG_NET_LOG=y
CONFIG_NET_SHELL=y
# Disable Wi-Fi shell, network is configured automatically during startup.
CONFIG_NET_L2_WIFI_SHELL=n

# Somehow CONFIG_SETTINGS and AUTO_INIT are needed, otherwise Wi-Fi connect fails
# with return value -1.
# https://docs.zephyrproject.org/latest/connectivity/networking/api/net_config.html
CONFIG_NET_CONFIG_SETTINGS=y
CONFIG_NET_CONFIG_AUTO_INIT=y

# L3 config
CONFIG_NET_IPV6=y
CONFIG_NET_IF_UNICAST_IPV6_ADDR_COUNT=4

CONFIG_NET_TX_STACK_SIZE=2048
CONFIG_NET_RX_STACK_SIZE=2048

CONFIG_APP_MCUMGR_OTA=y
```

## boards/esp32_devkitc_wrover.conf
```kconfig
CONFIG_ESP32_WIFI_STA_RECONNECT=y
```

## boards/xiao_esp32c3.conf
```kconfig
CONFIG_ESP32_WIFI_STA_RECONNECT=y
CONFIG_WIFI_NM=y
```

## boards/xiao_esp32c3.overlay
```dts
/*
 * SPDX-License-Identifier: Apache-2.0
 */

&wifi {
	status = "okay";
};
```

## src/main.c
```c
/*
 * SPDX-License-Identifier: Apache-2.0
 */

#include <zephyr/kernel.h>

#include <zephyr/logging/log.h>

LOG_MODULE_REGISTER(wifi_sensor, LOG_LEVEL_DBG);

#include "wifi.h"

int main(void) {
    LOG_INF("Start Wi-Fi sensor");

    /* Init network */


    wifi_connect();
    wait_for_wifi();
    wifi_status();

}
```

## src/wifi.c
```c
/*
 * SPDX-License-Identifier: Apache-2.0
 */

#include <zephyr/kernel.h>
#include <zephyr/net/net_if.h>
#include <zephyr/net/wifi_mgmt.h>
#include <zephyr/net/net_event.h>
#include <errno.h>

#include <zephyr/logging/log.h>

LOG_MODULE_REGISTER(wifi, LOG_LEVEL_DBG);

#define SSID "SSID"
#define PSK "PASSWORD"

static K_SEM_DEFINE(wifi_connected, 0, 1);

static struct net_mgmt_event_callback wifi_cb;

static void handle_wifi_connect_result(struct net_mgmt_event_callback *cb)
{
    const struct wifi_status *status = (const struct wifi_status *)cb->info;

    if (status->status)
    {
        LOG_INF("Connection request failed (%d)\n", status->status);
    }
    else
    {
        LOG_INF("Connected\n");
        k_sem_give(&wifi_connected);
    }
}

static void handle_wifi_disconnect_result(struct net_mgmt_event_callback *cb)
{
    const struct wifi_status *status = (const struct wifi_status *)cb->info;

    if (status->status)
    {
        printk("Disconnection request (%d)\n", status->status);
    }
    else
    {
        LOG_WRN("Disconnected\n");
        k_sem_take(&wifi_connected, K_NO_WAIT);
    }
}

static void wifi_mgmt_event_handler(struct net_mgmt_event_callback *cb, uint32_t mgmt_event, struct net_if *iface)
{
    switch (mgmt_event)
    {

        case NET_EVENT_WIFI_CONNECT_RESULT:
            handle_wifi_connect_result(cb);
            break;

        case NET_EVENT_WIFI_DISCONNECT_RESULT:
            handle_wifi_disconnect_result(cb);
            break;

        default:
            LOG_INF("Wi-Fi mgmt_event_handler, event: %d", mgmt_event);
            break;
    }
}

void wifi_connect(void)
{
    int ret;
    net_mgmt_init_event_callback(&wifi_cb, wifi_mgmt_event_handler,
                             NET_EVENT_WIFI_CONNECT_RESULT | NET_EVENT_WIFI_DISCONNECT_RESULT);

    net_mgmt_add_event_callback(&wifi_cb);

    struct net_if *iface = net_if_get_first_wifi();


    /* Setting the Wi-Fi interface into station mode is not strictly required
     * Do it anyway.
     */
    struct wifi_mode_info mode_info = {0};

    mode_info.oper = WIFI_MGMT_SET;
    mode_info.mode = WIFI_STA_MODE;
    ret = net_mgmt(NET_REQUEST_WIFI_MODE, iface, &mode_info, sizeof(mode_info));
    if (ret) {
        LOG_ERR("Set mode failed");
    }

    struct wifi_connect_req_params wifi_params = {0};

    wifi_params.ssid = SSID;
    wifi_params.psk = PSK;
    wifi_params.ssid_length = strlen(SSID);
    wifi_params.psk_length = strlen(PSK);
    wifi_params.channel = WIFI_CHANNEL_ANY;
    wifi_params.security = WIFI_SECURITY_TYPE_PSK;
    wifi_params.band = WIFI_FREQ_BAND_2_4_GHZ;
    wifi_params.mfp = WIFI_MFP_OPTIONAL;

    printk("Connecting to SSID: %s\n", wifi_params.ssid);

    if (net_mgmt(NET_REQUEST_WIFI_CONNECT, iface, &wifi_params, sizeof(struct wifi_connect_req_params)))
    {
        printk("WiFi Connection Request Failed\n");
    }
}

void wifi_status(void)
{
    struct net_if *iface = net_if_get_default();

    struct wifi_iface_status status = {0};

    if (net_mgmt(NET_REQUEST_WIFI_IFACE_STATUS, iface, &status,	sizeof(struct wifi_iface_status)))
    {
        printk("WiFi Status Request Failed\n");
    }

    printk("\n");

    if (status.state >= WIFI_STATE_ASSOCIATED) {
        printk("SSID: %-32s\n", status.ssid);
        printk("Band: %s\n", wifi_band_txt(status.band));
        printk("Channel: %d\n", status.channel);
        printk("Security: %s\n", wifi_security_txt(status.security));
        printk("RSSI: %d\n", status.rssi);
    }
}

void wifi_disconnect(void)
{
    struct net_if *iface = net_if_get_default();

    if (net_mgmt(NET_REQUEST_WIFI_DISCONNECT, iface, NULL, 0))
    {
        printk("WiFi Disconnection Request Failed\n");
    }
}

void wait_for_wifi(void) {
    k_sem_take(&wifi_connected, K_FOREVER);
}
```

## src/wifi.h
```c
/*
 * SPDX-License-Identifier: Apache-2.0
 */

void wifi_connect(void);
void wifi_status(void);
void wifi_disconnect(void);
void wait_for_wifi(void);
```
