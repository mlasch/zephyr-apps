## services/Kconfig
```kconfig
menu "Custom lwm2m client"

module "CUSTOM_SERVICES"
module-str = Custom lwm2m client
module-help = This is custom lwm2m client help

endmenu
```

## west.yml
```yaml
# zephyr-apps manifest
# author: mlasch@mailbox.org

manifest:
  remotes:
    - name: zephyrproject-rtos
      url-base: https://github.com/zephyrproject-rtos

  projects:
    - name: zephyr
      remote: zephyrproject-rtos
      import:
        name-whitelist:
          - hal_espressif
          - hal_xtensa
          - mbedtls
          - mcuboot
          - net-tools
          - zcbor
      revision: v3.6.0-rc2
  self:
    path: zephyr-apps
```
